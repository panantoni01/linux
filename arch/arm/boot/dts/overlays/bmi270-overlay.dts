/dts-v1/;
/plugin/;

/ {
    compatible = "brcm,bcm2835";

    fragment@0 {
        target = <&spi0>;
        __overlay__ {
            status = "okay";

            bmi270@0 {
                compatible = "bosch,bmi270";
                reg = <0>;
                spi-max-frequency = <5000000>;
                status = "okay";
            };
        };
    };
};
