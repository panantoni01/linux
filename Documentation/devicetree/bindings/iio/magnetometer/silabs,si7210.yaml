## Documentation/devicetree/bindings/iio/magnetometer/silabs,si7210.yaml
```yaml
# SPDX-License-Identifier: (GPL-2.0 OR BSD-2-Clause)
%YAML 1.2
---
$id: http://devicetree.org/schemas/iio/magnetometer/silabs,si7210.yaml
$schema: http://devicetree.org/meta-schemas/core.yaml#

title: SI7210 Hall Effect and Temperature sensor

maintainers:
  - Antoni Pokusinski <apokusinski01@gmail.com>

description: |
  Silabs SI7210 I2C Hall Effect Magnetic Position and Temperature Sensor.
  https://www.silabs.com/documents/public/data-sheets/si7210-datasheet.pdf

properties:
  compatible:
    const: silabs,si7210

  reg:
    maxItems: 1

  interrupts:
    maxItems: 1

  vdd-supply:
    description: Regulator that provides power to the sensor

required:
  - compatible
  - reg

additionalProperties: false

examples:
  - |
    #include <dt-bindings/interrupt-controller/irq.h>
    i2c {
        #address-cells = <1>;
        #size-cells = <0>;
        magnetometer@30 {
            compatible = "silabs,si7210";
            reg = <0x30>;
            interrupt-parent = <&gpio1>;
            interrupts = <4 IRQ_TYPE_EDGE_FALLING>;
            vdd-supply = <&vdd_3v3_reg>;
        };
    };
```
